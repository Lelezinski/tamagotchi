#include "utils.h"
#include <string.h>

// Global Game
volatile Game game = {0, {0, 0, 0}, MAX_STATS, MAX_STATS, STATE_IDLE, {0, 0, 200}};

/*----------------------------------------------------------------------------
  Utility Function
 *----------------------------------------------------------------------------*/

/**
 * @brief Custom System Initialization for this Application.
 * 	Initializes the Board, LEDs, Buttons, LCD, RIT and Timers
 * @param none
 */
void SysInit(void)
{
	SystemInit();
	LCD_Initialization();
	joystick_init();
	ADC_init();
	TP_Init();
	TouchPanel_Calibrate();
	init_RIT(1250000); // 50 ms RIT

	reset_timer(0);
	reset_timer(1);
	reset_timer(2);
	reset_timer(3);
	reset_RIT();
}

/**
 * @brief Converts Integer to String
 * @param string
 * @param number
 */
int toString(uint8_t *str, int num)
{
	int i, rem, len = 0, n;

	// Handling the case 0
	if (num == 0)
	{
		str[0] = '0';
		str[1] = '\0';
		return 1;
	}
	n = num;
	while (n != 0)
	{
		len++;
		n /= 10;
	}
	for (i = 0; i < len; i++)
	{
		rem = num % 10;
		num = num / 10;
		str[len - (i + 1)] = rem + '0';
	}
	str[len] = '\0';
	return len - 1;
}

void toHHMMSS(uint8_t *buffer, uint16_t hrs, uint8_t min, uint8_t sec)
{
	uint8_t temp[2];
	strcpy((char *)buffer, "Age ");

	// Hours
	if (hrs > 99)
	{
		// To not overflow strcat
		hrs = 99;
	}

	toString(temp, hrs);
	if (hrs < 10)
	{
		strcat((char *)buffer, "0");
	}
	strcat((char *)buffer, (char *)temp);

	// Mins
	strcat((char *)buffer, ":");
	toString(temp, min);
	if (min < 10)
	{
		strcat((char *)buffer, "0");
	}
	strcat((char *)buffer, (char *)temp);

	// Secs
	strcat((char *)buffer, ":");
	toString(temp, sec);
	if (sec < 10)
	{
		strcat((char *)buffer, "0");
	}
	strcat((char *)buffer, (char *)temp);
}

/**
 * @brief Reproduces the given note on the Loudspeaker output using MR0 TIM2 to generate the wanted frequence
 * @param note
 */
void playNote(uint32_t note)
{
	disable_timer(2);
	reset_timer(2);
	if (note > 200) 
	{
		// To lower bound is used to implement a pause 
		// and to avoid slowing down the system too much
		LPC_TIM2->MR0 = note;
		enable_timer(2);
	}
}

/**
 * @brief Plays the note array on the Loudspeaker using TIM3 and TIM2
 * @param notes
 */
void playSong(uint32_t * notes, uint32_t delay_ms)
{
	disable_timer(3);
	LPC_TIM3->MR0 = delay_ms;
	game.currentSong.notesArray = notes;
	game.currentSong.currentNote = 0;
	reset_timer(3);
	enable_timer(3);
}

/*----------------------------------------------------------------------------
  Globals
 *----------------------------------------------------------------------------*/

// Sound Effects
uint32_t se_menu[] = {NOTE_F4, NOTE_STOP};
uint32_t se_eat[] = {NOTE_D4, NOTE_PAUSE, NOTE_D4, NOTE_A4, NOTE_PAUSE, NOTE_D4, NOTE_PAUSE, NOTE_D4, NOTE_A4, NOTE_STOP};
uint32_t se_escape[] = {NOTE_F4, NOTE_E4, NOTE_D4, NOTE_C4, NOTE_STOP};
uint32_t se_cuddle[] = {NOTE_F4, NOTE_C4, NOTE_A4, NOTE_STOP};

// Animations
const uint8_t sprite_w = 16;
const uint8_t sprite_h = 16;
const uint8_t food_w = 8;
const uint8_t food_h = 8;
const uint8_t icon_w = 16;
const uint8_t icon_h = 16;
const uint8_t volume = 200;

const uint8_t anim_0_bin[] = {
  0xff, 0xff, 0xff, 0xff, 0xff, 0xff, 0xff, 0xff, 0xff, 0xff, 0xff, 0xff, 0xff, 0xff, 0xff, 0xff, 0xff, 0xff, 0xff, 0xff, 0xff, 0xff, 0xff, 0xff, 0xff, 0xff, 0xff, 0xff, 0xff, 0xff, 0xff, 0xff, 
  0xff, 0xff, 0xff, 0xff, 0xff, 0xff, 0xff, 0xff, 0xff, 0xff, 0x18, 0xc3, 0x18, 0xc3, 0x18, 0xc3, 0x18, 0xc3, 0x18, 0xc3, 0x18, 0xc3, 0x18, 0xc3, 0xff, 0xff, 0xff, 0xff, 0xff, 0xff, 0xff, 0xff, 
  0xff, 0xff, 0xff, 0xff, 0xff, 0xff, 0xff, 0xff, 0x10, 0x82, 0xec, 0x66, 0xec, 0x66, 0xec, 0x66, 0xec, 0x66, 0xec, 0x66, 0xec, 0x66, 0xec, 0x66, 0x18, 0xc3, 0xff, 0xff, 0xff, 0xff, 0xff, 0xff, 
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  0xff, 0xff, 0xff, 0xff, 0xff, 0xff, 0xff, 0xff, 0x10, 0x82, 0x10, 0x82, 0x10, 0x82, 0xff, 0xff, 0xff, 0xff, 0x10, 0x82, 0x10, 0x82, 0x10, 0x82, 0xff, 0xff, 0xff, 0xff, 0xff, 0xff, 0xff, 0xff, 
};

const uint8_t anim_1_bin[] = {
  0xff, 0xff, 0xff, 0xff, 0xff, 0xff, 0xff, 0xff, 0xff, 0xff, 0xff, 0xff, 0xff, 0xff, 0xff, 0xff, 0xff, 0xff, 0xff, 0xff, 0xff, 0xff, 0xff, 0xff, 0xff, 0xff, 0xff, 0xff, 0xff, 0xff, 0xff, 0xff, 
  0xff, 0xff, 0xff, 0xff, 0xff, 0xff, 0xff, 0xff, 0xff, 0xff, 0xff, 0xff, 0xff, 0xff, 0xff, 0xff, 0xff, 0xff, 0xff, 0xff, 0xff, 0xff, 0xff, 0xff, 0xff, 0xff, 0xff, 0xff, 0xff, 0xff, 0xff, 0xff, 
  0xff, 0xff, 0xff, 0xff, 0xff, 0xff, 0xff, 0xff, 0xff, 0xff, 0x18, 0xc3, 0x18, 0xc3, 0x18, 0xc3, 0x18, 0xc3, 0x18, 0xc3, 0x18, 0xc3, 0x18, 0xc3, 0xff, 0xff, 0xff, 0xff, 0xff, 0xff, 0xff, 0xff, 
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  0xff, 0xff, 0xff, 0xff, 0xff, 0xff, 0xff, 0xff, 0x18, 0xc3, 0x08, 0x61, 0x18, 0xc3, 0xff, 0xff, 0xff, 0xff, 0x18, 0xc3, 0x08, 0x61, 0x18, 0xc3, 0xff, 0xff, 0xff, 0xff, 0xff, 0xff, 0xff, 0xff, 
};

const uint8_t anim_eating_bin[] = {
  0xff, 0xff, 0xff, 0xff, 0xff, 0xff, 0xff, 0xff, 0xff, 0xff, 0xff, 0xff, 0xff, 0xff, 0xff, 0xff, 0xff, 0xff, 0xff, 0xff, 0xff, 0xff, 0xff, 0xff, 0xff, 0xff, 0xff, 0xff, 0xff, 0xff, 0xff, 0xff, 
  0xff, 0xff, 0xff, 0xff, 0xff, 0xff, 0xff, 0xff, 0xff, 0xff, 0x08, 0x40, 0x08, 0x40, 0x08, 0x40, 0x08, 0x40, 0x08, 0x40, 0x08, 0x40, 0x08, 0x40, 0xff, 0xff, 0xff, 0xff, 0xff, 0xff, 0xff, 0xff, 
  0xff, 0xff, 0xff, 0xff, 0xff, 0xff, 0xff, 0xff, 0x08, 0x40, 0xf4, 0xa6, 0xf4, 0xa6, 0xf4, 0xa6, 0xf4, 0xa6, 0xf4, 0xa6, 0xf4, 0xa6, 0xf4, 0xa6, 0x08, 0x40, 0xff, 0xff, 0xff, 0xff, 0xff, 0xff, 
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  0xff, 0xff, 0xff, 0xff, 0xff, 0xff, 0xff, 0xff, 0x08, 0x40, 0x08, 0x40, 0x08, 0x40, 0xff, 0xff, 0xff, 0xff, 0x08, 0x40, 0x08, 0x40, 0x08, 0x40, 0xff, 0xff, 0xff, 0xff, 0xff, 0xff, 0xff, 0xff, 
};

const uint8_t anim_walking_1_bin[] = {
  0xff, 0xff, 0xff, 0xff, 0xff, 0xff, 0xff, 0xff, 0xff, 0xff, 0xff, 0xff, 0xff, 0xff, 0xff, 0xff, 0xff, 0xff, 0xff, 0xff, 0xff, 0xff, 0xff, 0xff, 0xff, 0xff, 0xff, 0xff, 0xff, 0xff, 0xff, 0xff, 
  0xff, 0xff, 0xff, 0xff, 0xff, 0xff, 0xff, 0xff, 0xff, 0xff, 0x10, 0xa0, 0x10, 0xa0, 0x10, 0xa0, 0x10, 0xa0, 0x10, 0xa0, 0x10, 0xa0, 0x10, 0xa0, 0xff, 0xff, 0xff, 0xff, 0xff, 0xff, 0xff, 0xff, 
  0xff, 0xff, 0xff, 0xff, 0xff, 0xff, 0xff, 0xff, 0x10, 0xa0, 0xfd, 0x06, 0xfd, 0x06, 0xfd, 0x06, 0xfd, 0x06, 0xfd, 0x06, 0xfd, 0x06, 0xfd, 0x06, 0x10, 0xa0, 0xff, 0xff, 0xff, 0xff, 0xff, 0xff, 
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  0xff, 0xff, 0xff, 0xff, 0x10, 0x60, 0x10, 0x60, 0xff, 0xff, 0xff, 0xff, 0xff, 0xff, 0xff, 0xff, 0xff, 0xff, 0xff, 0xff, 0xff, 0xff, 0x10, 0xa0, 0x10, 0x60, 0x10, 0x60, 0xff, 0xff, 0xff, 0xff, 
};

const uint8_t anim_walking_2_bin[] = {
  0xff, 0xff, 0xff, 0xff, 0xff, 0xff, 0xff, 0xff, 0xff, 0xff, 0xff, 0xff, 0xff, 0xff, 0xff, 0xff, 0xff, 0xff, 0xff, 0xff, 0xff, 0xff, 0xff, 0xff, 0xff, 0xff, 0xff, 0xff, 0xff, 0xff, 0xff, 0xff, 
  0xff, 0xff, 0xff, 0xff, 0xff, 0xff, 0xff, 0xff, 0xff, 0xff, 0x10, 0xa0, 0x10, 0xa0, 0x10, 0xa0, 0x10, 0xa0, 0x10, 0xa0, 0x10, 0xa0, 0x10, 0xa0, 0xff, 0xff, 0xff, 0xff, 0xff, 0xff, 0xff, 0xff, 
  0xff, 0xff, 0xff, 0xff, 0xff, 0xff, 0xff, 0xff, 0x10, 0xa0, 0xfd, 0x06, 0xfd, 0x06, 0xfd, 0x06, 0xfd, 0x06, 0xfd, 0x06, 0xfd, 0x06, 0xfd, 0x06, 0x10, 0xa0, 0xff, 0xff, 0xff, 0xff, 0xff, 0xff, 
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  0xff, 0xff, 0xff, 0xff, 0xff, 0xff, 0xff, 0xff, 0xff, 0xff, 0xff, 0xff, 0x08, 0x40, 0x10, 0x60, 0x10, 0x60, 0xff, 0xff, 0xff, 0xff, 0xff, 0xff, 0xff, 0xff, 0xff, 0xff, 0xff, 0xff, 0xff, 0xff, 
};

const uint8_t anim_escaping_1_bin[] = {
  0xff, 0xff, 0xff, 0xff, 0xff, 0xff, 0xff, 0xff, 0xff, 0xff, 0xff, 0xff, 0xff, 0xff, 0xff, 0xff, 0xff, 0xff, 0xff, 0xff, 0xff, 0xff, 0xff, 0xff, 0xff, 0xff, 0xff, 0xff, 0xff, 0xff, 0xff, 0xff, 
  0xff, 0xff, 0xff, 0xff, 0xff, 0xff, 0xff, 0xff, 0xff, 0xff, 0x10, 0xa0, 0x10, 0xa0, 0x10, 0xa0, 0x10, 0xa0, 0x10, 0xa0, 0x10, 0xa0, 0x10, 0xa0, 0xff, 0xff, 0xff, 0xff, 0xff, 0xff, 0xff, 0xff, 
  0xff, 0xff, 0xff, 0xff, 0xff, 0xff, 0xff, 0xff, 0x10, 0xa0, 0xfd, 0x06, 0xfd, 0x06, 0xfd, 0x06, 0xfd, 0x06, 0xfd, 0x06, 0xfd, 0x06, 0xfd, 0x06, 0x10, 0xa0, 0xff, 0xff, 0xff, 0xff, 0xff, 0xff, 
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  0xff, 0xff, 0xff, 0xff, 0xff, 0xff, 0xff, 0xff, 0xff, 0xff, 0xff, 0xff, 0x08, 0x40, 0x10, 0x60, 0x10, 0x60, 0xff, 0xff, 0xff, 0xff, 0xff, 0xff, 0xff, 0xff, 0xff, 0xff, 0xff, 0xff, 0xff, 0xff, 
};

const uint8_t anim_escaping_2_bin[] = {
  0xff, 0xff, 0xff, 0xff, 0xff, 0xff, 0xff, 0xff, 0xff, 0xff, 0xff, 0xff, 0xff, 0xff, 0xff, 0xff, 0xff, 0xff, 0xff, 0xff, 0xff, 0xff, 0xff, 0xff, 0xff, 0xff, 0xff, 0xff, 0xff, 0xff, 0xff, 0xff, 
  0xff, 0xff, 0xff, 0xff, 0xff, 0xff, 0xff, 0xff, 0xff, 0xff, 0x10, 0xa0, 0x10, 0xa0, 0x10, 0xa0, 0x10, 0xa0, 0x10, 0xa0, 0x10, 0xa0, 0x10, 0xa0, 0xff, 0xff, 0xff, 0xff, 0xff, 0xff, 0xff, 0xff, 
  0xff, 0xff, 0xff, 0xff, 0xff, 0xff, 0xff, 0xff, 0x10, 0xa0, 0xfd, 0x06, 0xfd, 0x06, 0xfd, 0x06, 0xfd, 0x06, 0xfd, 0x06, 0xfd, 0x06, 0xfd, 0x06, 0x10, 0xa0, 0xff, 0xff, 0xff, 0xff, 0xff, 0xff, 
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  0xff, 0xff, 0xff, 0xff, 0x10, 0x60, 0x10, 0x60, 0xff, 0xff, 0xff, 0xff, 0xff, 0xff, 0xff, 0xff, 0xff, 0xff, 0xff, 0xff, 0xff, 0xff, 0x10, 0xa0, 0x10, 0x60, 0x10, 0x60, 0xff, 0xff, 0xff, 0xff, 
};

const uint8_t food_pizza_bin[] = {
  0xff, 0xff, 0xff, 0xff, 0xff, 0xff, 0xff, 0xff, 0xff, 0xff, 0xff, 0xff, 0xff, 0xff, 0xff, 0xff, 
  0xff, 0xff, 0xff, 0xff, 0x10, 0x20, 0x10, 0x20, 0x10, 0x20, 0x10, 0x20, 0xff, 0xff, 0xff, 0xff, 
  0xff, 0xff, 0x10, 0x20, 0xed, 0x20, 0xed, 0x20, 0xed, 0x20, 0xed, 0x20, 0x10, 0x20, 0xff, 0xff, 
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  0xff, 0xff, 0xff, 0xff, 0x10, 0x20, 0x10, 0x20, 0x10, 0x20, 0x10, 0x20, 0xff, 0xff, 0xff, 0xff, 
};

const uint8_t food_choco_bin[] = {
  0xff, 0xff, 0xff, 0xff, 0xff, 0xff, 0xff, 0xff, 0xff, 0xff, 0xff, 0xff, 0xff, 0xff, 0xff, 0xff, 
  0xff, 0xff, 0xff, 0xff, 0xff, 0xff, 0xff, 0xff, 0xff, 0xff, 0xff, 0xff, 0xff, 0xff, 0xff, 0xff, 
  0xff, 0xff, 0x08, 0x20, 0x08, 0x20, 0x08, 0x20, 0x08, 0x20, 0x08, 0x20, 0x08, 0x20, 0xff, 0xff, 
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  0xff, 0xff, 0xff, 0xff, 0xff, 0xff, 0xff, 0xff, 0xff, 0xff, 0xff, 0xff, 0xff, 0xff, 0xff, 0xff, 
};

const uint8_t anim_cuddle_bin[] = {
  0xff, 0xff, 0xff, 0xff, 0xff, 0xff, 0xff, 0xff, 0xff, 0xff, 0xff, 0xff, 0xff, 0xff, 0xff, 0xff, 0xff, 0xff, 0xff, 0xff, 0xff, 0xff, 0xff, 0xff, 0xff, 0xff, 0xff, 0xff, 0xff, 0xff, 0xff, 0xff, 
  0xff, 0xff, 0xff, 0xff, 0xff, 0xff, 0xff, 0xff, 0xff, 0xff, 0x18, 0xc3, 0x18, 0xc3, 0x18, 0xc3, 0x18, 0xc3, 0x18, 0xc3, 0x18, 0xc3, 0x18, 0xc3, 0xff, 0xff, 0xff, 0xff, 0xff, 0xff, 0xff, 0xff, 
  0xff, 0xff, 0xff, 0xff, 0xff, 0xff, 0xff, 0xff, 0x10, 0x82, 0xec, 0x66, 0xec, 0x66, 0xec, 0x66, 0xec, 0x66, 0xec, 0x66, 0xec, 0x66, 0xec, 0x66, 0x18, 0xc3, 0xff, 0xff, 0xff, 0xff, 0xff, 0xff, 
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  0xff, 0xff, 0xff, 0xff, 0xff, 0xff, 0xff, 0xff, 0x10, 0x82, 0x10, 0x82, 0x10, 0x82, 0xff, 0xff, 0xff, 0xff, 0x10, 0x82, 0x10, 0x82, 0x10, 0x82, 0xff, 0xff, 0xff, 0xff, 0xff, 0xff, 0xff, 0xff, 
};

const uint8_t icon_audio_on[] = {
  0xff, 0xff, 0xff, 0xff, 0xff, 0xff, 0xff, 0xff, 0xff, 0xff, 0xff, 0xff, 0xff, 0xff, 0xff, 0xff, 0x08, 0x21, 0x08, 0x21, 0xff, 0xff, 0xff, 0xff, 0xff, 0xff, 0xff, 0xff, 0xff, 0xff, 0x08, 0x21, 
  0xff, 0xff, 0xff, 0xff, 0xff, 0xff, 0xff, 0xff, 0xff, 0xff, 0xff, 0xff, 0xff, 0xff, 0x08, 0x21, 0x08, 0x21, 0x08, 0x21, 0xff, 0xff, 0xff, 0xff, 0xff, 0xff, 0xff, 0xff, 0xff, 0xff, 0x08, 0x21, 
  0xff, 0xff, 0xff, 0xff, 0xff, 0xff, 0xff, 0xff, 0xff, 0xff, 0xff, 0xff, 0x08, 0x21, 0x08, 0x21, 0x08, 0x21, 0x08, 0x21, 0xff, 0xff, 0xff, 0xff, 0xff, 0xff, 0x08, 0x21, 0xff, 0xff, 0x08, 0x21, 
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  0xff, 0xff, 0xff, 0xff, 0xff, 0xff, 0xff, 0xff, 0xff, 0xff, 0xff, 0xff, 0xff, 0xff, 0xff, 0xff, 0x08, 0x21, 0x08, 0x21, 0xff, 0xff, 0xff, 0xff, 0xff, 0xff, 0xff, 0xff, 0xff, 0xff, 0x08, 0x21, 
};

const uint8_t icon_audio_off[] = {
  0xff, 0xff, 0xff, 0xff, 0xff, 0xff, 0xff, 0xff, 0xff, 0xff, 0xff, 0xff, 0xff, 0xff, 0xff, 0xff, 0x08, 0x41, 0x08, 0x41, 0xff, 0xff, 0xff, 0xff, 0xff, 0xff, 0xf8, 0x41, 0xff, 0xff, 0xff, 0xff, 
  0xff, 0xff, 0xff, 0xff, 0xff, 0xff, 0xff, 0xff, 0xff, 0xff, 0xff, 0xff, 0xff, 0xff, 0x08, 0x41, 0x08, 0x41, 0x08, 0x41, 0xff, 0xff, 0xff, 0xff, 0xf8, 0x41, 0xf8, 0x41, 0xf8, 0x41, 0xff, 0xff, 
  0xff, 0xff, 0xff, 0xff, 0xff, 0xff, 0xff, 0xff, 0xff, 0xff, 0xff, 0xff, 0x08, 0x41, 0x08, 0x41, 0x08, 0x41, 0x08, 0x41, 0xff, 0xff, 0xf8, 0x41, 0xf8, 0x41, 0xf8, 0x41, 0xf8, 0x41, 0xf8, 0x41, 
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  0xff, 0xff, 0xff, 0xff, 0xf8, 0x41, 0xff, 0xff, 0xff, 0xff, 0xff, 0xff, 0xff, 0xff, 0xff, 0xff, 0x08, 0x41, 0x08, 0x41, 0xff, 0xff, 0xff, 0xff, 0xff, 0xff, 0xff, 0xff, 0xff, 0xff, 0xff, 0xff, 
};
